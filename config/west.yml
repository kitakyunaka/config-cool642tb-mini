## config/west.yml
```yaml
manifest:  
  remotes:  
    - name: zmkfirmware  
      url-base: https://github.com/zmkfirmware  
    - name: na-ka-no
      url-base: https://github.com/na-ka-no
  
  projects:  
    - name: zmk
      remote: zmkfirmware  # フォークしたリポジトリを参照  
      revision: v0.2.1  # カスタムブランチ名  
      import: app/west.yml  
    - name: zmk-pmw3610-driver  
      remote: na-ka-no
      revision: main  
  
  self:  
    path: config
```
